## bgt-linux-pcie-drv/linux/drivers/media/common/tuners/Kconfig
```kconfig
config MEDIA_ATTACH
	bool "Load and attach frontend and tuner driver modules as needed"
	depends on VIDEO_MEDIA
	depends on MODULES
	help
	  Remove the static dependency of DVB card drivers on all
	  frontend modules for all possible card variants. Instead,
	  allow the card drivers to only load the frontend modules
	  they require.

	  Also, tuner module will automatically load a tuner driver
	  when needed, for analog mode.

	  This saves several KBytes of memory.

	  Note: You will need module-init-tools v3.2 or later for this feature.

	  If unsure say Y.

config MEDIA_TUNER
	tristate
	default VIDEO_MEDIA && I2C
	depends on VIDEO_MEDIA && I2C
	select MEDIA_TUNER_XC2028 if !MEDIA_TUNER_CUSTOMISE
	select MEDIA_TUNER_XC5000 if !MEDIA_TUNER_CUSTOMISE
	select MEDIA_TUNER_MT20XX if !MEDIA_TUNER_CUSTOMISE
	select MEDIA_TUNER_TDA8290 if !MEDIA_TUNER_CUSTOMISE
	select MEDIA_TUNER_TEA5761 if !MEDIA_TUNER_CUSTOMISE
	select MEDIA_TUNER_TEA5767 if !MEDIA_TUNER_CUSTOMISE
	select MEDIA_TUNER_SIMPLE if !MEDIA_TUNER_CUSTOMISE
	select MEDIA_TUNER_TDA9887 if !MEDIA_TUNER_CUSTOMISE
	select MEDIA_TUNER_MC44S803 if !MEDIA_TUNER_CUSTOMISE

menuconfig MEDIA_TUNER_CUSTOMISE
	bool "Customize analog and hybrid tuner modules to build"
	depends on MEDIA_TUNER
	default n
	help
	  This allows the user to deselect tuner drivers unnecessary
	  for their hardware from the build. Use this option with care
	  as deselecting tuner drivers which are in fact necessary will
	  result in V4L/DVB devices which cannot be tuned due to lack of
	  driver support

	  If unsure say N.

if MEDIA_TUNER_CUSTOMISE

config MEDIA_TUNER_SIMPLE
	tristate "Simple tuner support"
	depends on VIDEO_MEDIA && I2C
	select MEDIA_TUNER_TDA9887
	default m if MEDIA_TUNER_CUSTOMISE
	help
	  Say Y here to include support for various simple tuners.

config MEDIA_TUNER_TDA18271
	tristate "NXP TDA18271 silicon tuner"
	depends on VIDEO_MEDIA && I2C
	default m if MEDIA_TUNER_CUSTOMISE
	help
	  A silicon tuner module. Say Y when you want to support this tuner.


endif # MEDIA_TUNER_CUSTOMISE
```

## bgt-linux-pcie-drv/linux/drivers/media/dvb/Kconfig
```kconfig
#
# DVB device configuration
#

config DVB_DYNAMIC_MINORS
	bool "Dynamic DVB minor allocation"
	depends on DVB_CORE
	default n
	help
	  If you say Y here, the DVB subsystem will use dynamic minor
	  allocation for any device that uses the DVB major number.
	  This means that you can have more than 4 of a single type
	  of device (like demuxes and frontends) per adapter, but udev
	  will be required to manage the device nodes.

	  If you are unsure about this, say N here.

menuconfig DVB_CAPTURE_DRIVERS
	bool "DVB/ATSC adapters"
	depends on DVB_CORE
	default y
	---help---
	  Say Y to select Digital TV adapters

if DVB_CAPTURE_DRIVERS && DVB_CORE

comment "Supported DVB Frontends"
	depends on DVB_CORE
source "drivers/media/dvb/frontends/Kconfig"

endif # DVB_CAPTURE_DRIVERS
```

## bgt-linux-pcie-drv/linux/drivers/media/dvb/frontends/Kconfig
```kconfig
config DVB_FE_CUSTOMISE
	bool "Customise the frontend modules to build"
	depends on DVB_CORE
	default N
	help
	  This allows the user to select/deselect frontend drivers for their
	  hardware from the build.

	  Use this option with care as deselecting frontends which are in fact
	  necessary will result in DVB devices which cannot be tuned due to lack
	  of driver support.

	  If unsure say N.

if DVB_FE_CUSTOMISE

menu "Customise DVB Frontends"

comment "Multistandard (satellite) frontends"
	depends on DVB_CORE

config DVB_STV090x
	tristate "STV0900/STV0903(A/B) based"
	depends on DVB_CORE && I2C
	default m if DVB_FE_CUSTOMISE
	help
	  DVB-S/S2/DSS Multistandard Professional/Broadcast demodulators.
	  Say Y when you want to support these frontends.

config DVB_STV6110x
	tristate "STV6110/(A) based tuners"
	depends on DVB_CORE && I2C
	default m if DVB_FE_CUSTOMISE
	help
	  A Silicon tuner that supports DVB-S and DVB-S2 modes

config DVB_CXD2850
	tristate "Sony CXD2850"
	depends on DVB_CORE && I2C
	default m if DVB_FE_CUSTOMISE
	help
	  Say Y when you want to support this frontend.

comment "DVB-S (satellite) frontends"
	depends on DVB_CORE

comment "Multistandard frontends"
	depends on DVB_CORE

config DVB_TDA18272
	tristate "NXP TDA18272 based"
	depends on DVB_CORE && I2C
	default m if DVB_FE_CUSTOMISE
	help
	  A silicon tuner module. Say Y when you want to support this tuner.

config DVB_TDA10048
	tristate "Philips TDA10048HN based"
	depends on DVB_CORE && I2C
	default m if DVB_FE_CUSTOMISE
	help
	  A DVB-T tuner module. Say Y when you want to support this frontend.

config DVB_S5H1411
	tristate "Samsung S5H1411 based"
	depends on DVB_CORE && I2C
	default m if DVB_FE_CUSTOMISE
	help
	  An ATSC 8VSB and QAM64/256 tuner module. Say Y when you want
	  to support this frontend.

comment "SEC control devices for DVB-S"
	depends on DVB_CORE

config DVB_LNBP21
	tristate "LNBP21/LNBH24 SEC controllers"
	depends on DVB_CORE && I2C
	default m if DVB_FE_CUSTOMISE
	help
	  An SEC control chips.

config DVB_A8290
	tristate "Allegro A8290 SEC controller"
	depends on DVB_CORE && I2C
	default m if DVB_FE_CUSTOMISE
	help
	  A SEC controller.

comment "Tools to develop new frontends"

config DVB_DUMMY_FE
	tristate "Dummy frontend driver"
	default n

config DVB_CXD2820R
	tristate "Sony CXD2820R"
	depends on DVB_CORE && I2C
	default m if DVB_FE_CUSTOMISE
	help
	  Say Y when you want to support this frontend.

config DVB_CXD2834
	tristate "Sony CXD2834"
	depends on DVB_CORE && I2C
	default m if DVB_FE_CUSTOMISE
	help
	  Say Y when you want to support this frontend.

config DVB_CXD2817
	tristate "Sony CXD2817"
	depends on DVB_CORE && I2C
	default m if DVB_FE_CUSTOMISE
	help
	  Say Y when you want to support this frontend.

config DVB_CXD2861
	tristate "Sony CXD2861"
	depends on DVB_CORE && I2C
	default m if DVB_FE_CUSTOMISE
	help
	  Say Y when you want to support this tuner

endmenu

endif
```

## bgt-linux-pcie-drv/linux/drivers/media/saa7231/Kconfig
```kconfig
config SAA7231_CORE
	tristate "SAA7231 PCI Express bridge based devices"
	depends on PCI && I2C

	help
	  Support for PCI cards based on the SAA7231 PCI Express bridge.

	  Say Y if you own such a device and want to use it.

config SAA7231_DRV
	tristate "SAA7231 based PCIe cards"
	depends on SAA7231_CORE && PCI && I2C

	help
	  Support for the SAA7231 based Hybrid PCIe DVB cards
	  Currently supported devices are:

	  * NXP Reference (Purus)

	  Say Y if you own such a device and want to use it.
```

## bgt-linux-pcie-drv/linux/drivers/media/video/Kconfig
```kconfig
#
# Generic video config states
#

config VIDEO_V4L2
	tristate
	depends on VIDEO_DEV && VIDEO_V4L2_COMMON
	default VIDEO_DEV && VIDEO_V4L2_COMMON

config VIDEO_V4L1
	tristate
	depends on VIDEO_DEV && VIDEO_V4L2_COMMON && VIDEO_ALLOW_V4L1
	default VIDEO_DEV && VIDEO_V4L2_COMMON && VIDEO_ALLOW_V4L1

config VIDEOBUF_GEN
	tristate

config VIDEOBUF_DMA_SG
	depends on HAS_DMA
	select VIDEOBUF_GEN
	tristate

config VIDEOBUF_VMALLOC
	select VIDEOBUF_GEN
	tristate

config VIDEOBUF_DMA_CONTIG
	depends on HAS_DMA
	select VIDEOBUF_GEN
	tristate

config VIDEOBUF_DVB
	tristate
	select VIDEOBUF_GEN

#config VIDEO_BTCX
#	depends on PCI
#	tristate

#config VIDEO_IR
#	tristate
#	depends on INPUT

#config VIDEO_TVEEPROM
#	tristate
#	depends on I2C

#config VIDEO_TUNER
#	tristate
#	depends on MEDIA_TUNER

#
# Multimedia Video device configuration
#

menuconfig VIDEO_CAPTURE_DRIVERS
	bool "Video capture adapters"
	depends on VIDEO_V4L2
	default y
	---help---
	  Say Y here to enable selecting the video adapters for
	  webcams, analog TV, and hybrid analog/digital TV.
	  Some of those devices also supports FM radio.
```

## bgt-linux-pcie-drv/v4l/Kconfig.sound
```kconfig
menu "Audio devices for multimedia"

# This is part of sound/pci/Kconfig
comment "ALSA sound"

config SND_BT87X
	tristate "Bt87x Audio Capture"
	depends on SND && PCI
	select SND_PCM
	help
	  If you want to record audio from TV cards based on
	  Brooktree Bt878/Bt879 chips, say Y here and read
	  <Documentation/sound/alsa/Bt87x.txt>.

	  To compile this driver as a module, choose M here: the module
	  will be called snd-bt87x.

config SND_BT87X_OVERCLOCK
	bool "Bt87x Audio overclocking"
	depends on SND_BT87X
	help
	  Say Y here if 448000 Hz isn't enough for you and you want to
	  record from the analog input with up to 1792000 Hz.

	  Higher sample rates won't hurt your hardware, but audio
	  quality may suffer.

config SND_FM801_TEA575X
	tristate "ForteMedia FM801 TEA5757 tuner"
	depends on VIDEO_V4L1 && SND_FM801

	help
	  Say Y here to include support for soundcards based on the ForteMedia
	  FM801 chip with a TEA5757 tuner connected to GPIO1-3 pins (Media
	  Forte SF256-PCS-02) into the snd-fm801 driver.

	  This will enable support for the old V4L1 API.

endmenu
```
